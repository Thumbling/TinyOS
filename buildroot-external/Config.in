## buildroot-external/Config.in
```kconfig
menu "TinyOS firmware"

source "$BR2_EXTERNAL_TINYOS_PATH/package/lvgl/Config.in"
source "$BR2_EXTERNAL_TINYOS_PATH/package/tinyos/Config.in"

endmenu
```

## buildroot-external/configs/tinyos_rg_nano_defconfig
```kconfig
# TinyOS — Anbernic RG Nano
BR2_arm=y
BR2_cortex_a7=y
BR2_ARM_EABIHF=y
BR2_ARM_FPU_NEON_VFPV4=y

BR2_TOOLCHAIN_BUILDROOT_MUSL=y

BR2_TARGET_GENERIC_HOSTNAME="tinyos"
BR2_TARGET_GENERIC_ISSUE="Welcome to TinyOS"
BR2_TARGET_GENERIC_ROOT_PASSWD=""
BR2_TARGET_GENERIC_GETTY_PORT=""
BR2_TARGET_GENERIC_REMOUNT_ROOTFS_RW=y

BR2_ROOTFS_OVERLAY="$(BR2_EXTERNAL_TINYOS_PATH)/board/rg-nano/rootfs-overlay"
BR2_ROOTFS_POST_BUILD_SCRIPT="$(BR2_EXTERNAL_TINYOS_PATH)/board/rg-nano/post-build.sh"
BR2_ROOTFS_POST_IMAGE_SCRIPT="$(BR2_EXTERNAL_TINYOS_PATH)/board/rg-nano/post-image.sh"

BR2_LINUX_KERNEL=y
BR2_LINUX_KERNEL_CUSTOM_VERSION=y
BR2_LINUX_KERNEL_CUSTOM_VERSION_VALUE="6.12.115"
BR2_LINUX_KERNEL_USE_DEFCONFIG=y
BR2_LINUX_KERNEL_DEFCONFIG="sunxi"
BR2_LINUX_KERNEL_CONFIG_FRAGMENT_FILES="$(BR2_EXTERNAL_TINYOS_PATH)/board/rg-nano/linux.fragment"
BR2_LINUX_KERNEL_DTS_SUPPORT=y
BR2_LINUX_KERNEL_INTREE_DTS_NAME="allwinner/sun8i-v3s-anbernic-rg-nano"
BR2_LINUX_KERNEL_INSTALL_TARGET=y
BR2_LINUX_KERNEL_NEEDS_HOST_OPENSSL=y

BR2_TARGET_UBOOT=y
BR2_TARGET_UBOOT_BUILD_SYSTEM_KCONFIG=y
BR2_TARGET_UBOOT_CUSTOM_VERSION=y
BR2_TARGET_UBOOT_CUSTOM_VERSION_VALUE="2025.10"
BR2_TARGET_UBOOT_BOARD_DEFCONFIG="LicheePi_Zero"
BR2_TARGET_UBOOT_CONFIG_FRAGMENT_FILES="$(BR2_EXTERNAL_TINYOS_PATH)/board/rg-nano/uboot/tinyos_rg_nano.fragment"
BR2_TARGET_UBOOT_NEEDS_DTC=y
BR2_TARGET_UBOOT_NEEDS_PYTHON3=y
BR2_TARGET_UBOOT_NEEDS_PYLIBFDT=y
BR2_TARGET_UBOOT_NEEDS_OPENSSL=y
BR2_TARGET_UBOOT_NEEDS_GNUTLS=y
BR2_TARGET_UBOOT_SPL=y
BR2_TARGET_UBOOT_SPL_NAME="u-boot-sunxi-with-spl.bin"

BR2_TARGET_ROOTFS_EXT2=y
BR2_TARGET_ROOTFS_EXT2_4=y
BR2_TARGET_ROOTFS_EXT2_SIZE="512M"
BR2_TARGET_ROOTFS_EXT2_LABEL="TINYOS_ROOT"

BR2_PACKAGE_HOST_GENIMAGE=y
BR2_PACKAGE_HOST_UBOOT_TOOLS=y
BR2_PACKAGE_HOST_UBOOT_TOOLS_BOOT_SCRIPT=y
BR2_PACKAGE_HOST_UBOOT_TOOLS_BOOT_SCRIPT_SOURCE="$(BR2_EXTERNAL_TINYOS_PATH)/board/rg-nano/boot.cmd"
BR2_PACKAGE_HOST_DOSFSTOOLS=y
BR2_PACKAGE_HOST_E2FSPROGS=y

BR2_PACKAGE_BUSYBOX=y
BR2_PACKAGE_ALSA_LIB=y
BR2_PACKAGE_ALSA_UTILS=y
BR2_PACKAGE_ALSA_UTILS_APLAY=y
BR2_PACKAGE_LVGL=y
BR2_PACKAGE_TINYOS=y

BR2_PACKAGE_PANEL_MIPI_DBI_FIRMWARE=y
BR2_PACKAGE_PANEL_MIPI_DBI_FIRMWARE_SOURCE="$(BR2_EXTERNAL_TINYOS_PATH)/board/rg-nano/firmware/saef,sftc154b.txt"
```

## buildroot-external/package/lvgl/Config.in
```kconfig
config BR2_PACKAGE_LVGL
	bool "lvgl"
	help
	  Light and Versatile Graphics Library 9.6.

	  TinyOS uses the MIT-licensed LVGL 9.6 renderer with a static
	  configuration generated from config/lv_conf.h. The library is
	  built as a static archive and linked directly into the TinyOS
	  binary; no runtime configuration files are needed.

	  https://lvgl.io/
```

## buildroot-external/package/tinyos/Config.in
```kconfig
config BR2_PACKAGE_TINYOS
	bool "tinyos"
	depends on BR2_PACKAGE_LVGL
	depends on BR2_TOOLCHAIN_HAS_THREADS
	select BR2_PACKAGE_ALSA_LIB
	help
	  TinyOS, the modular firmware for the Anbernic RG Nano.

	  Builds the LVGL user interface, evdev keypad input, fbdev display
	  output, AXP209 power telemetry, the ALSA WAV player and the mGBA
	  Game Boy / Game Boy Color / Game Boy Advance cores. The resulting
	  /usr/bin/tinyos is started by the board inittab and renders
	  directly to /dev/fb0. ROMs are read from /data/roms; no ROM or BIOS
	  is installed by this package.

	  https://github.com/Thumbling/TinyOS
```
